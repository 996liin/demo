#include "headfile.h"
/*
	热像数据：广角->长焦
*/
#if IRLENS == IRLENS_186 && (IRCCD == IRCCD_HK640 || IRCCD == IRCCD_S640)
#define IrZoomViewBufSize	85
static unsigned short IrZoomViewBuf[IrZoomViewBufSize][4] = 
{
	{	0 	,	2056 	,	1651 	,	300 	,},
	{	1 	,	1990 	,	1598 	,	310 	,},
	{	1 	,	1927 	,	1547 	,	321 	,},
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	{	83 	,	346 	,	277 	,	1800 	,},

};
#elif IRLENS == IRLENS_155 && (IRCCD == IRCCD_HK640 || IRCCD == IRCCD_S640)
#define IrZoomViewBufSize	348
static unsigned short IrZoomViewBuf[IrZoomViewBufSize][4] = 
{
	{	348	,	2056	,	1651	,	300 	,},
	{	347	,	2047	,	1644	,	301 	,},
	{	346	,	2042	,	1640	,	302 	,},
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	{	1	,	415	,	332	,	1500 	,},

};
#elif IRLENS == IRLENS_230 && (IRCCD == IRCCD_HK640 || IRCCD == IRCCD_S640)
#define IrZoomViewBufSize	301
static unsigned short IrZoomViewBuf[IrZoomViewBufSize][4] = 
{
	{	301	,	3062	,	2471	,	199	,},
	{	300	,	3049	,	2460	,	200	,},
	{	299	,	3036	,	2449	,	201	,},
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	{	1	,	271	,	217	,	2300	,},

};
#endif
/*
	可见光数据：长焦->广角
*/
#if CAMLENS == CAMLENS_HUAGUO750
#define CamZoomViewBufSize	21
static unsigned short CamZoomViewBuf[CamZoomViewBufSize][4] = 
{
	{	1	,	59	,	33 	,	7480},
	{	2	,	70	,	39 	,	6324},
	{	3	,	86	,	48 	,	5111},
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	{	21	,	3423,	1902 ,	126},
};
#elif CAMLENS == CAMLENS_JINGGONG500
#define CamZoomViewBufSize	30
static unsigned short CamZoomViewBuf[CamZoomViewBufSize][5] = 
{
	{	30 	,	89 	,	50 	,	5000 	,	2290 	,},
	{	29 	,	99 	,	56 	,	4500 	,	2280 	,},
	{	28 	,	111 	,	62 	,	4000 	,	2270 	,},
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	{	1 	,	2901 	,	1654 	,	150 	,	200 	,},

};

#elif CAMLENS == CAMLENS_FUSHINENG750
#define CamZoomViewBufSize	241
static unsigned short CamZoomViewBuf[CamZoomViewBufSize][4] = 
{
	{	241	,	50 	,	28 	,	960	,	7500 	,},
	{	240	,	51 	,	28 	,	956	,	7375 	,},
	{	239	,	52 	,	29 	,	952	,	7250 	,},
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	{	1	,	2887 	,	1604 	,	40	,	125 	,},
};
#endif
//自检
static unsigned char ucLensSelfCheckOutTimeFlag = 0;
static unsigned int uiLensSelfCheckOutTimeCnt = 0;

static unsigned short usCamZoomADMax = 0;
static unsigned short usCamZoomADMin = 0;
static unsigned char ucCamZoomSelfCheckDir = 0;
static unsigned short usCamFocusADMax = 2500;
static unsigned short usCamFocusADMin = 1000;
static unsigned char ucCamFocusSelfCheckDir = 0;

static unsigned short usIrZoomADMax = 0;
static unsigned short usIrZoomADMin = 0;
static unsigned char ucIrZoomSelfCheckDir = 0;
static unsigned short usIrFocusADMax = 0;
static unsigned short usIrFocusADMin = 0;
static unsigned char ucIrFocusSelfCheckDir = 0;
static unsigned char ucLensData[20] = {0,};

//镜头运行
static unsigned char ucCamZoomRunFlag = 0;
static unsigned char ucIrZoomRunFlag = 0;

static unsigned char ucCamFocusSmallStepRunDir = 0;
static unsigned int uiCamFocusSmallStepRunCnt = 0;
static unsigned char ucCamFocusSmallStepRunStop = 0;
static unsigned char ucIrFocusSmallStepRunDir = 0;
static unsigned int uiIrFocusSmallStepRunCnt = 0;
static unsigned char ucIrFocusSmallStepRunStop = 0;

//速度控制
static unsigned char ucCamZoomRunDir = 0;
static unsigned char ucCamZoomRunCnt = 0;
static float fCamZoomRunSpeedCtrlLevel = 1.0;

static unsigned char ucCamFocusRunDir = 0;
static unsigned char ucCamFocusRunCnt = 0;
static float fCamFocusRunSpeedCtrlLevel = 1.0;

static unsigned char ucIrZoomRunDir = 0;
static unsigned char ucIrZoomRunCnt = 0;
static float fIrZoomRunSpeedCtrlLevel = 1.0;

static unsigned char ucIrFocusRunDir = 0;
static unsigned char ucIrFocusRunCnt = 0;
static float fIrFocusRunSpeedCtrlLevel = 1.0;

//定位
static unsigned short usLocatCamZoomPosi = 0;
static unsigned char ucLocatCamZoomFlag = 0;
static unsigned short usLocatCamFocusPosi = 0;
static unsigned char ucLocatCamFocusFlag = 0;
static unsigned char ucPreciLocatCamFocusPosiFlag = 0;	//精确定位标志

static unsigned short usLocatIrZoomPosi = 0;
static unsigned char ucLocatIrZoomFlag = 0;
static unsigned short usLocatIrFocusPosi = 0;
static unsigned char ucLocatIrFocusFlag = 0;
static unsigned char ucPreciLocatIrFocusPosiFlag = 0;	//精确定位标志

unsigned char ucLocatIrZoomStep = 0,ucLocatIrFocusStep = 0;

unsigned short usIrZoomValue = 0,usIrViewValue = 0;


unsigned short GetCamADcnt = 0;
static unsigned short usReturnCnt = 0;
static unsigned char ucReturnStep = 0;

/*
	函数实现
*/
static void init(void);
static void LensSelfCheck(void);
static void LensTimer(void);
static void CamAutoFocus(void);
static void IrAutoFocus(void);
static void SetCamZoomPosi(unsigned short usTargetAD);
static void SetCamFocusPosi(unsigned short usTargetAD);
static void SetIrZoomPosi(unsigned short usTargetAD);
static void SetIrFocusPosi(unsigned short usTargetAD);
static unsigned char GetCamZoomCheckDir(void);
static unsigned char GetIrZoomCheckDir(void);
static void LensCam(unsigned char cmd);
static void LensLaser(unsigned char cmd);
static void CamLensValueInit(unsigned char ucOperation);

/*		
	函数结构体-外部
*/
static Struct_Lens s_Lens = 
{
	.init = init,
	.LensSelfCheck = LensSelfCheck,
	.LensTimer = LensTimer,
	.CamAutoFocus = CamAutoFocus,
	.IrAutoFocus = IrAutoFocus,
	.SetCamZoomPosi = SetCamZoomPosi,
	.SetCamFocusPosi = SetCamFocusPosi,
	.SetIrZoomPosi = SetIrZoomPosi,
	.SetIrFocusPosi = SetIrFocusPosi,
	.LensCam = LensCam,
	.LensLaser = LensLaser,
};
Struct_Lens *ps_Lens = &s_Lens;
/*		
	参数结构体-内部
*/
Struct_LensPara s_LensPara = {0,};
/*
		到位标志结构体-外部
*/
static struct_Arr s_Arr = {0,};
struct_Arr *ps_Arr = &s_Arr;

/*		
	初始化
*/
static void LensGPIOInit(void)
{
	rcu_periph_clock_enable(RCU_GPIOB);
	rcu_periph_clock_enable(RCU_GPIOA);
	//MOTOR1 
	gpio_mode_set(GPIOB, GPIO_MODE_OUTPUT, GPIO_PUPD_PULLDOWN, GPIO_PIN_0|GPIO_PIN_1);
	gpio_output_options_set(GPIOB, GPIO_OTYPE_PP, GPIO_OSPEED_50MHZ,GPIO_PIN_0|GPIO_PIN_1);
  //MOTOR2
	gpio_mode_set(GPIOA, GPIO_MODE_OUTPUT, GPIO_PUPD_PULLDOWN, GPIO_PIN_6|GPIO_PIN_7);
	gpio_output_options_set(GPIOA, GPIO_OTYPE_PP, GPIO_OSPEED_50MHZ,GPIO_PIN_6|GPIO_PIN_7);
	//	//EN
	gpio_mode_set(GPIOC, GPIO_MODE_OUTPUT, GPIO_PUPD_PULLDOWN, GPIO_PIN_5);
	gpio_output_options_set(GPIOC, GPIO_OTYPE_PP, GPIO_OSPEED_50MHZ,GPIO_PIN_5);
	gpio_bit_write(GPIOC,GPIO_PIN_5,RESET);
	ps_Systick->delay_ms(500);ps_Systick->delay_ms(500);
	gpio_bit_write(GPIOC,GPIO_PIN_5,SET);
//	gpio_bit_write(GPIOB,GPIO_PIN_0,RESET);
//	gpio_bit_write(GPIOB,GPIO_PIN_1,RESET);
	
}
static void LensParaInit(unsigned char ucOperation)
{
	
}
static void init(void)
{
	LensGPIOInit();
	CamLensValueInit(0);
}
/*		
	镜头控制
*/
static void CamZoomTele(void)
{
	gpio_bit_write(GPIOB,GPIO_PIN_0,RESET);
	gpio_bit_write(GPIOB,GPIO_PIN_1,SET);
}
static void CamZoomWide(void)
{
	gpio_bit_write(GPIOB,GPIO_PIN_0,SET);
	gpio_bit_write(GPIOB,GPIO_PIN_1,RESET);
}
static void CamZoomStop(void)
{
	gpio_bit_write(GPIOB,GPIO_PIN_0,RESET);
	gpio_bit_write(GPIOB,GPIO_PIN_1,RESET);
}
static void CamFocusNear(void)
{	
	gpio_bit_write(GPIOA,GPIO_PIN_6,SET);	
	gpio_bit_write(GPIOA,GPIO_PIN_7,RESET);
}
static void CamFocusFar(void)
{
	gpio_bit_write(GPIOA,GPIO_PIN_6,RESET);	
	gpio_bit_write(GPIOA,GPIO_PIN_7,SET);	
}
static void CamFocusStop(void)
{	
	gpio_bit_write(GPIOA,GPIO_PIN_6,RESET);	
	gpio_bit_write(GPIOA,GPIO_PIN_7,RESET);
}

/*		
	速度控制
*/
static void CamZoomCtrl(void)
{
	unsigned short usZoom;
	if(ucCamZoomRunDir)
	{
		ucCamZoomRunCnt++;
		
		if(ucCamZoomRunCnt <= SPEEDCYCLE)
		{
			if(LENSRUN_TELE == ucCamZoomRunDir)
			{
				CamZoomTele();
				if(!s_Lens.ucCamSelfCheckFlag)
				{
					if(1 == ucCamZoomSelfCheckDir)
					{
						if(s_Lens.usZoomValue <= usCamZoomADMin)
						{
							CamZoomStop();
							ucCamZoomRunDir = LENSRUN_STOP;
						}
					}
					else
					{
						if(s_Lens.usZoomValue >= usCamZoomADMax)
						{
							CamZoomStop();
							ucCamZoomRunDir = LENSRUN_STOP;
						}

					}
				}
			}
			else
			{
				CamZoomWide();
				if(!s_Lens.ucCamSelfCheckFlag)
				{
					if(1 == ucCamZoomSelfCheckDir)
					{
						if(s_Lens.usZoomValue >= usCamZoomADMax)
						{
							CamZoomStop();
							ucCamZoomRunDir = LENSRUN_STOP;
						}
					}
					else
					{
						if(s_Lens.usZoomValue <= usCamZoomADMin)
						{
							CamZoomStop();
							ucCamZoomRunDir = LENSRUN_STOP;
						}
					}
				}
			}
		}
		else
		{
			CamZoomStop();
		}
		if(ucCamZoomRunCnt >= SPEEDCYCLE*4)
		{
			ucCamZoomRunCnt = 0;
		}
	}
}
static void CamFocusCtrl(void)
{
	if(ucCamFocusRunDir)
	{
		ucCamFocusRunCnt++;
		
		if(ucCamFocusRunCnt <= SPEEDCYCLE)
		{
			if(LENSRUN_NEAR == ucCamFocusRunDir)
			{
				CamFocusNear();
				if(s_Lens.usFocusValue <= usCamFocusADMin)
				{
					CamFocusStop();
					ucCamFocusRunDir = LENSRUN_STOP;
				}
			}
			else
			{
				CamFocusFar();
				if(s_Lens.usFocusValue >= usCamFocusADMax)
				{
					CamFocusStop();
					ucCamFocusRunDir = LENSRUN_STOP;
				}
			}
		}
		else
		{
			CamFocusStop();
		}
		
		if(ucCamFocusRunCnt == SPEEDCYCLE*3)
		{
			ucCamFocusRunCnt = 0;
		}
	}
}
static void IrZoomCtrl(void)
{
	
}

static void IrFocusCtrl(void)
{
	
}
/*		
	聚焦微动处理
*/
static void FocusSmallSteplRun(void)
{
	
}

/*		
	自检
*/
static unsigned char CamLensSelfCheck(void)
{
	static unsigned char ucCamZoomCheckStatus = 0;
	static unsigned char ucCamZoomCheckCnt = 0;
	static unsigned char ucCamZoomCheckFinish = 0;

	static unsigned char ucCamFocusCheckStatus = 0;
	static unsigned char ucCamFocusCheckCnt = 0;
	static unsigned char ucCamFocusCheckFinish = 0;
	
	static unsigned short usCamZoomTeleAD = 0;
	static unsigned short usCamZoomWideAD = 0;
	static unsigned short usCamFocusNearAD = 0;
	static unsigned short usCamFocusFarAD = 0;
	static unsigned short usData1 = 0, usData2 = 0;
	
	if(0 == ucCamZoomCheckStatus)
	{
		LensLaser(1);
		
		usData1 = ps_ADC->GetCamZoomAD();
		ps_Systick->delay_ms(400);
		usData2 = ps_ADC->GetCamZoomAD();
		
		if(abs(usData1 - usData2) <= 50)
		{
			ucCamZoomCheckCnt++;
			if(ucCamZoomCheckCnt >= 3)
			{
				ucCamZoomCheckCnt = 0;
				ucCamZoomCheckStatus = 1;
				LensLaser(3);
				usCamZoomTeleAD = ps_ADC->GetCamZoomAD();
			}
		}
	}
	else if(1 == ucCamZoomCheckStatus)
	{
		LensLaser(2);
		
		usData1 = ps_ADC->GetCamZoomAD();
		ps_Systick->delay_ms(400);
		usData2 = ps_ADC->GetCamZoomAD();
		
		if(abs(usData1 - usData2) <= 50)
		{
			ucCamZoomCheckCnt++;
			if(ucCamZoomCheckCnt >= 3)
			{
				ucCamZoomCheckCnt = 0;
				ucCamZoomCheckStatus = 2;
				LensLaser(3);
				usCamZoomWideAD = ps_ADC->GetCamZoomAD();
			}
		}
	}
	else if(2 == ucCamZoomCheckStatus)
	{
		if(abs(usCamZoomWideAD - usCamZoomTeleAD) > 600)
		{
			if(usCamZoomWideAD > usCamZoomTeleAD)
			{
				ucCamZoomSelfCheckDir = 1;
				usCamZoomADMax = usCamZoomWideAD;
				usCamZoomADMin = usCamZoomTeleAD;
			}
			else
			{
				ucCamZoomSelfCheckDir = 0;
				usCamZoomADMax = usCamZoomTeleAD;
				usCamZoomADMin = usCamZoomWideAD;
			}
			ucCamZoomCheckFinish = 1;
		}
		else
		{
			ucCamZoomCheckFinish = 0;
		}	
		ucCamZoomCheckStatus = 3;
	}
	if(3 == ucCamZoomCheckStatus)
	{
		unsigned char ucSelfCheckStatus = 0;
		
		if(ucCamZoomCheckFinish)
		{
			ucSelfCheckStatus |= 1;
		}
		ucCamZoomCheckStatus = 0;
		return ucSelfCheckStatus;
	}
	else
	{
		return 0;
	}
}
static unsigned char IrLensSelfCheck(void)
{	
	
}
static void CamLensValueInit(unsigned char ucOperation)
{
	if(1 == ucOperation)	//自检成功，保存数据
	{
		ucLensData[0] = usCamZoomADMax >> 8;
		ucLensData[1] = usCamZoomADMax & 0xff;
		ucLensData[2] = usCamZoomADMin >> 8;
		ucLensData[3] = usCamZoomADMin & 0xff;
		ucLensData[4] = ucCamZoomSelfCheckDir;
		ps_AT24CXX->AT24CXX_Write(CAMSELFDATAADDR,ucLensData,5);
	}
	else if(0 == ucOperation)	//自检失败，读取之前的数据
	{
//		ps_AT24CXX->AT24CXX_Read(CAMSELFDATAADDR,ucLensData,5);
//		
//		usCamZoomADMax = (ucLensData[0] << 8 | ucLensData[1]) - 100;
//		usCamZoomADMin = (ucLensData[2] << 8 | ucLensData[3]) + 100;
//		ucCamZoomSelfCheckDir = ucLensData[4];
		usCamZoomADMax = 0xfff - 100;
		usCamZoomADMin = 100;
		ucCamZoomSelfCheckDir = 1;
	}
	else{}
}
static void IrLensValueInit(unsigned char ucOperation)
{	
	
}
static void LensSelfCheck(void)
{
	 ucLensSelfCheckOutTimeFlag = 1;
	uiLensSelfCheckOutTimeCnt = 0;
	
	unsigned char ucCamLensSelfCheckStatus = 0,ucIrLensSelfCheckStatus = 0;
	
	while(1)
	{
		ucCamLensSelfCheckStatus = CamLensSelfCheck();
    s_Lens.ucCamSelfCheckFlag = 1;
		//2min超时保护
		if(uiLensSelfCheckOutTimeCnt >= (120 * 20000) || ucCamLensSelfCheckStatus)
		{
			ucLensSelfCheckOutTimeFlag = 0;
			break;
		}
	}
	s_Lens.ucCamSelfCheckFlag = 0;
	CamLensValueInit(ucCamLensSelfCheckStatus);
}

static unsigned char GetCamZoomCheckDir(void)
{
	return ucCamZoomSelfCheckDir;
}
static unsigned char GetIrZoomCheckDir(void)
{
	return ucIrZoomSelfCheckDir;
}
/*		
	定位
*/
static void SetCamZoomPosi(unsigned short usTargetAD)
{
	ucLocatCamZoomFlag = 1;
	usLocatCamZoomPosi = usTargetAD;
}
static void SetCamFocusPosi(unsigned short usTargetAD)
{
	ucLocatCamFocusFlag = 1;
	usLocatCamFocusPosi = usTargetAD;
}
static void SetIrZoomPosi(unsigned short usTargetAD)
{
	ucLocatIrZoomFlag = 1;
	usLocatIrZoomPosi = usTargetAD;
}
static void SetIrFocusPosi(unsigned short usTargetAD)
{
	ucLocatIrFocusFlag = 1;
	usLocatIrFocusPosi = usTargetAD;
}
static void LocatCamZoomAD(unsigned short usTargetZoom)
{
	if( usTargetZoom >= usCamZoomADMax )
	{
		usTargetZoom = usCamZoomADMax;
	}
	else if( usTargetZoom <= usCamZoomADMin )
	{
		usTargetZoom = usCamZoomADMin;
	}
	//unsigned short usCamNowZoom = ps_ADC->GetCamZoomAD();
	
	if(abs(s_Lens.usZoomValue - usTargetZoom) > 15)
	{
		ps_Arr->ucCamZoomArr = 0;
		
		if(usTargetZoom > s_Lens.usZoomValue )
		{
			if(1 == ucCamZoomSelfCheckDir)
			{
				ucCamZoomRunDir = LENSRUN_WIDE;
			}
			else
			{
				ucCamZoomRunDir = LENSRUN_TELE;
			}
		}
		else
		{
			if(1 == ucCamZoomSelfCheckDir)
			{
				ucCamZoomRunDir = LENSRUN_TELE;
			}
			else
			{
				ucCamZoomRunDir = LENSRUN_WIDE;
			}
		}
	}
	else
	{
		ucCamZoomRunDir = LENSRUN_STOP;
		CamZoomStop();
		ucLocatCamZoomFlag = 0;
		ps_Arr->ucCamZoomArr = 1;
	}
	
}
static void LocatCamFocusAD(unsigned short usTargetFocus)
{
	if( usTargetFocus >= usCamFocusADMax )
	{
		usTargetFocus = usCamFocusADMax;
	}
	else if( usTargetFocus <= usCamFocusADMin )
	{
		usTargetFocus = usCamFocusADMin;
	}
	//unsigned short usCamNowFocus = ps_ADC->GetCamFocusAD();
	
	if(abs(s_Lens.usFocusValue - usTargetFocus) > 8)
	{
		ps_Arr->ucCamFocusArr = 0;
		
		if(usTargetFocus > s_Lens.usFocusValue )
		{
			if(1 == ucCamFocusSelfCheckDir)
			{
				ucCamFocusRunDir = LENSRUN_FAR;
			}
			else
			{
				ucCamFocusRunDir = LENSRUN_NEAR;
			}
		}
		else
		{
			if(1 == ucCamFocusSelfCheckDir)
			{
				ucCamFocusRunDir = LENSRUN_NEAR;
			}
			else
			{
				ucCamFocusRunDir = LENSRUN_FAR;
			}
		}
	}
	else
	{
		if(1 == ucPreciLocatCamFocusPosiFlag)
		{
			if(abs(s_Lens.usFocusValue - usTargetFocus) > 2)
			{
				fCamFocusRunSpeedCtrlLevel = 0.5;
				
				ps_Arr->ucCamFocusArr = 0;
			
				if(usTargetFocus > s_Lens.usFocusValue)
				{
					if(1 == ucCamFocusSelfCheckDir)
					{
						ucCamFocusRunDir = LENSRUN_FAR;
					}
					else
					{
						ucCamFocusRunDir = LENSRUN_NEAR;
					}
				}
				else
				{
					if(1 == ucCamFocusSelfCheckDir)
					{
						ucCamFocusRunDir = LENSRUN_NEAR;
					}
					else
					{
						ucCamFocusRunDir = LENSRUN_FAR;
					}
				}
			}
			else
			{
				ucCamFocusRunDir = LENSRUN_STOP;
				CamFocusStop();
				ps_Arr->ucCamFocusArr = 1;
				ucPreciLocatCamFocusPosiFlag = 0;
				ucLocatCamFocusFlag = 0;
			}
		}
		else
		{
			ucCamFocusRunDir = LENSRUN_STOP;
			CamFocusStop();
			ps_Arr->ucCamFocusArr = 1;
			ucLocatCamFocusFlag = 0;
		}
	}
}


static void LocatIrZoomAD(unsigned short usTargetZoom)
{
	
	
}
static void LocatIrFocusAD(unsigned short usTargetFocus)
{

}
void LocatLensPosi(void)
{
	  if(ucLocatCamZoomFlag)
		{
			LocatCamZoomAD(usLocatCamZoomPosi);
		}
		if(ucLocatCamFocusFlag)
		{
			LocatCamFocusAD(usLocatCamFocusPosi);
		}
}

/*		
	自动聚焦
*/
static void CamAutoFocus(void)
{
	
}
static void IrAutoFocus(void)
{
	
}
static void AouoFocusTrig(void)
{
	
}

/*		
	温控自动聚焦
*/
static void TempTrigAutoFocus(void)
{

}

/*		
	定时器处理
*/
static void LensTimer(void)
{
	if(GetCamADcnt > 0)
	{
	  GetCamADcnt--;
	}
	else
	{
	  GetCamADcnt = 2000;//100ms
		s_Lens.usZoomValue = ps_ADC->GetCamZoomAD();
		s_Lens.usFocusValue = ps_ADC->GetCamFocusAD();
		
	}
	CamZoomCtrl();
	CamFocusCtrl();
	LocatLensPosi();
	if(ucLensSelfCheckOutTimeFlag)
	{
		uiLensSelfCheckOutTimeCnt++;
	}
}
/*
	实时回传，跟踪用
*/
unsigned char ucReturnCom[] = {0xff,0x01,0x00,0x00,0x00,0x00,0x00};
static void returnLensData(void)	//返回镜头数据
{
	
}
unsigned short ustest_camzoom = 0,ustest_camfocus = 0,ustest_irzoom = 0,ustest_irfocus = 0,ustest_flag = 0,ustest_time = 1;
static void LensCam(unsigned char cmd)
{
	switch (cmd)
	{
		case 0x01:
		{
			ucLocatCamFocusFlag = 0;
			ucCamFocusRunDir = LENSRUN_NEAR;
		  break;
		}
	  case 0x02:
		{
			ucLocatCamFocusFlag = 0;
			ucCamFocusRunDir = LENSRUN_FAR;
		  break;
		}
		case 0x03:
		{
			ucLocatCamFocusFlag = 0;
			if(ucCamFocusRunDir)
			{
				ucCamFocusRunDir = LENSRUN_STOP;
				CamFocusStop();
			}		
		  break;
		}
		default :
			break;
	}
}
static void LensLaser(unsigned char cmd)
{
	switch (cmd)
	{
		case 0x01:
		{
			ucLocatCamZoomFlag = 0;
			ucCamZoomRunDir = LENSRUN_TELE;
		  break;
		}
	  case 0x02:
		{
			ucLocatCamZoomFlag = 0;
			ucCamZoomRunDir = LENSRUN_WIDE;
		  break;
		}
		case 0x03:
		{
			ucLocatCamZoomFlag = 0;
			if(ucCamZoomRunDir)
			{
				ucCamZoomRunDir = LENSRUN_STOP;
				CamZoomStop();
			}		
		  break;
		}
		default :
			break;
	}
}
